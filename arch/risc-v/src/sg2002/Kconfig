## arch/risc-v/src/sg2002/Kconfig
```kconfig
config SG2002_QEMU_SIM
    bool "qemu sim"
    default n

config SG2002_I2C1
    bool "i2c1 enable"
    default n

config SG2002_I2C3
    bool "i2c3 enable"
    default n

config SG2002_SPI2
    bool "spi2 enable"
    default n

config SG2002_SPI3
    bool "spi3 enable"
    default n

config MBOX
    bool "mailbox enable"
    default y
```
